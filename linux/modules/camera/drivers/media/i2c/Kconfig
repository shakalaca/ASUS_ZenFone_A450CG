## linux/modules/camera/drivers/media/i2c/Kconfig
```kconfig
#
# Kconfig for sensor drivers
#

source "drivers/external_drivers/camera/drivers/media/i2c/mt9e013/Kconfig"
source "drivers/external_drivers/camera/drivers/media/i2c/imx/Kconfig"
source "drivers/external_drivers/camera/drivers/media/i2c/imx219/Kconfig"
source "drivers/external_drivers/camera/drivers/media/i2c/imx135VB/Kconfig"

config VIDEO_OV9724
       tristate "OVT ov9724 sensor support"
       depends on I2C && VIDEO_V4L2
       ---help---
         This is a Video4Linux2 sensor-level driver for the OVT
         OV9724 raw camera.

         OVT is a 720P raw sensor.

         It currently only works with the atomisp driver.

config VIDEO_OV2722
       tristate "OVT ov2722 sensor support"
       depends on I2C && VIDEO_V4L2
       ---help---
         This is a Video4Linux2 sensor-level driver for the OVT
         OV2722 raw camera.

         OVT is a 2M raw sensor.

         It currently only works with the atomisp driver.

config VIDEO_OV8830
       tristate "Omnivision ov8830 sensor support"
       depends on I2C && VIDEO_V4L2 && VIDEO_ATOMISP
       ---help---
         This is a Video4Linux2 sensor-level driver for the Omnivision
         ov8830 8MP RAW sensor.

         It currently only works with the atomisp driver.

config VIDEO_MSRLIST_HELPER
       tristate "Helper library to load, parse and apply large register lists."
       depends on I2C
       ---help---
         This is a helper library to be used from a sensor driver to load, parse
         and apply large register lists.

         To compile this driver as a module, choose M here: the
         module will be called libmsrlisthelper.

config VIDEO_S5K8AAY
       tristate "Samsung S5K8AAY (EVT1) sensor support"
       depends on I2C && VIDEO_V4L2 && VIDEO_ATOMISP && VIDEO_MSRLIST_HELPER
       ---help---
         This is a Video4Linux2 sensor-level driver for the Samsung
         S5K8AAY (EVT1) 1/8" 1.2MP SoC sensor.

         It currently only works with the atomisp driver.

config VIDEO_MT9D113
       tristate "Aptina mt9d113 sensor support"
       depends on I2C && VIDEO_V4L2
       ---help---
         This is a Video4Linux2 sensor-level driver for the Micron
         mt9d113 2M camera.

         mt9d113 is video camera sensor.

         It currently only works with the atomisp driver.
config VIDEO_MT9M114
       tristate "Aptina mt9m114 sensor support"
       depends on I2C && VIDEO_V4L2
       ---help---
         This is a Video4Linux2 sensor-level driver for the Micron
         mt9m114 1.3 Mpixel camera.

         mt9m114 is video camrea sensor.

config VIDEO_MT9M114_RAW
       tristate "Aptina mt9m114_raw sensor support"
       depends on I2C && VIDEO_V4L2
       ---help---
         This is a Video4Linux2 sensor-level driver for the Micron
         mt9m114 1.3 Mpixel camera.

         mt9m114 is video camrea sensor.

config VIDEO_MT9V113
       tristate "Aptina mt9v113 sensor support"
       depends on I2C && VIDEO_V4L2
       ---help---
         This is a Video4Linux2 sensor-level driver for the Micron
         mt9v113 vga camera.

         mt9v113 is video camerea sensor.

         It currently only works with the atomisp driver.

config VIDEO_OV5640
       tristate "Omnivision ov5640 sensor support"
       depends on I2C && VIDEO_V4L2
       ---help---
         This is a Video4Linux2 sensor-level driver for the Micron
         ov5640 5 Mpixel camera.

         ov5640 is video camrea sensor.

         It currently only works with the atomisp driver.

config VIDEO_SPCA700XA
        tristate "iCatch SPCA700XA support"
        depends on SPI
        ---help---
          SPCA700XA chip support

config VIDEO_OV5693
        tristate "Omnivision ov5693 with iCatch ISP sensor support"
        depends on I2C && VIDEO_V4L2
        ---help---
           This is a Video4Linux2 sensor-level driver for the Omnivision
           ov5693 5 Mpixel camera.

           ov5693 is video camrea sensor.

           It currently only works with the atomisp driver.

config VIDEO_AR0543
        tristate "Aptina ar5693 with iCatch ISP sensor support"
        depends on I2C && VIDEO_V4L2
        ---help---
           This is a Video4Linux2 sensor-level driver for the Aptina
           ar0543 5 Mpixel camera.

           ar0543 is video camrea sensor.

           It currently only works with the atomisp driver.

config VIDEO_AR0543_RAW
        tristate "Aptina ar5693_raw with raw sensor support"
        depends on I2C && VIDEO_V4L2
        ---help---
           This is a Video4Linux2 sensor-level driver for the Aptina
           ar0543 5 Mpixel camera.

           ar0543 is video camrea sensor.

           It currently only works with the atomisp driver.

config VIDEO_IMX111_RAW
        tristate "Sony imx111_raw with raw sensor support"
        depends on I2C && VIDEO_V4L2
        ---help---
           This is a Video4Linux2 sensor-level driver for the Sony
           imx111 8 Mpixel camera.

           imx111 is video camrea sensor.

           It currently only works with the atomisp driver.

config VIDEO_GC0339_RAW
        tristate "GalaxyCore gc0339_raw with raw sensor support"
        depends on I2C && VIDEO_V4L2
        ---help---
           This is a Video4Linux2 sensor-level driver for the Galaxycore
           gc0339_raw 0.3 Mpixel camera.

           gc0339_raw is video camrea sensor.

           It currently only works with the atomisp driver.

config VIDEO_HM2056_RAW
        tristate "Himax hm2056_raw with raw sensor support"
        depends on I2C && VIDEO_V4L2
        ---help---
           This is a Video4Linux2 sensor-level driver for the Himax
           hm2056_raw 2 Mpixel camera.

           hm2056_raw is video camrea sensor.

           It currently only works with the atomisp driver.

#
# Kconfig for flash drivers
#

config VIDEO_LM3554
       tristate "LM3554 flash light driver"
       depends on VIDEO_V4L2 && I2C
       ---help---
         This is a Video4Linux2 sub-dev driver for the LM3554
         flash light driver.

         To compile this driver as a module, choose M here: the
         module will be called lm3554

config VIDEO_LM3559
       tristate "LM3559 flash light driver"
       depends on VIDEO_V4L2 && I2C
       ---help---
         This is a Video4Linux2 sub-dev driver for the LM3559
         flash light driver.

         To compile this driver as a module, choose M here: the
         module will be called lm3559
```

## linux/modules/drivers/regulator/Kconfig
```kconfig
config REGULATOR_PMIC_AVP
        tristate "PMIC Avondale Cove voltage regulator"
        help
          This driver controls a intel pmic avatele voltage output regulator

config MMC_SD_VCCSDIO_ALWAYS_ON
        bool "VCCSDIO always on"
        depends on REGULATOR_PMIC_AVP
        help
          This option controls whether VCCSDIO is AON or not
```
